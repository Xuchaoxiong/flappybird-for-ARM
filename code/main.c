

/*
 * main.c
 */

#include <stdint.h>
#include <stdbool.h>
#include "driverlib/adc.h"
#include "driverlib/gpio.h"
#include "driverlib/rom.h"
#include "driverlib/interrupt.h"
#include "driverlib/sysctl.h"
#include "inc/hw_memmap.h"
#include "inc/hw_ints.h"
#include "LCDDriver.h"
#include "inc/hw_gpio.h"



#include <stdlib.h> 
#include <stdio.h> 
#include <time.h>
#include "font.h"

extern void screenpage(char page,unsigned char *p,int l);
bool push=0;

unsigned char a1[]={0,0,0,0,0,0,0,0,0,0,0,0,0,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0,0};
unsigned char b1[]={0,0,0,0,0,0,0,0,0,0,0,0,0,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0,0};
unsigned char c1[]={0,0,0,0,0,0,0,0,0,0,0,0,0,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0,0};
unsigned char d1[]={0,0,0,0,0,0,0,0,0,0,0,0,0,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0,0};
unsigned char e1[]={0,0,0,0,0,0,0,0,0,0,0,0,0,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0,0};
unsigned char f1[]={0,0,0,0,0,0,0,0,112,120,124,126,126,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0,0};
unsigned char g1[]={0,0,0,0,0,0,0,0,0,0,0,0,0,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0,0};
unsigned char h1[]={0,0,0,0,0,0,0,0,0,0,0,0,0,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0,0};
	
	
unsigned char a2[]={0,0,0,0,0,0,0,0,0,0,0,0,0,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0,0};
unsigned char b2[]={0,0,0,0,0,0,0,0,0,0,0,0,0,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0,0};
unsigned char c2[]={0,0,0,0,0,0,0,0,0,0,0,0,0,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0,0};
unsigned char d2[]={0,0,0,0,0,0,0,0,0,0,0,0,0,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0,0};
unsigned char e2[]={0,0,0,0,0,0,0,0,0,0,0,0,0,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0,0};
unsigned char f2[]={0,0,0,0,0,0,0,0,0,0,0,0,0,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0,0};
unsigned char g2[]={0,0,0,0,0,0,0,0,0,0,0,0,0,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0,0};
unsigned char h2[]={0,0,0,0,0,0,0,0,0,0,0,0,0,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0,0};
	
	
unsigned char a3[]={0,0,0,0,0,0,0,0,0,0,0,0,0,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0,0};
unsigned char b3[]={0,0,0,0,0,0,0,0,0,0,0,0,0,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0,0};
unsigned char c3[]={0,0,0,0,0,0,0,0,0,0,0,0,0,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0,0};
unsigned char d3[]={0,0,0,0,0,0,0,0,0,0,0,0,0,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0,0};
unsigned char e3[]={0,0,0,0,0,0,0,0,0,0,0,0,0,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0,0};
unsigned char f3[]={0,0,0,0,0,0,0,0,0,0,0,0,0,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0,0};
unsigned char g3[]={0,0,0,0,0,0,0,0,0,0,0,0,0,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0,0};
unsigned char h3[]={0,0,0,0,0,0,0,0,0,0,0,0,0,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0,0};
	
	
	
	
	union screen {
	char a;
	struct {
		char bit1 :1;
		char bit2 :1;
		char bit3 :1;
		char bit4 :1;
		char bit5 :1;
		char bit6 :1;
		char bit7 :1;
		char bit8 :1;
	};
};


enum
{
	LINE_ONE,
	LINE_TWO,
	LINE_THREE,
	LINE_FOUR,

	LINE_NUM
}line_define;

//#define CHAR_WIDTH			8
#define WORD_WIDTH			16

#ifndef TARGET_IS_BLIZZARD_RA1
#define TARGET_IS_BLIZZARD_RA1
#endif

/***************************************************************
 * @brief	LCD模块按键响应中断 PC7 对应的为按键S1
 * @param	null
 * @return  null
***************************************************************/
extern uint8_t VCA_BUTTON_UP_DOWM;
char cur_Col = 0;
//中断处理子函数
void Int_GPIO_D_Handler(void)
{
	unsigned long ulStatus;
	// 读取中断状态
	ulStatus = GPIOIntStatus(GPIO_PORTD_BASE, true);
	// 清除中断状态
	GPIOIntClear(GPIO_PORTD_BASE, ulStatus);
	// 如果KEY的中断状态有效
	if (ulStatus & GPIO_PIN_7)
	{
		// 延时约10ms，消除按键抖动
		// 等待KEY抬起
		while (GPIOPinRead(GPIO_PORTD_BASE, GPIO_PIN_7) == 0x00);
		// 延时约10ms，消除松键抖动
		//TODO 逻辑处理
		push = 1;
		if(cur_Col < (NUM_CHAR - 1))
			cur_Col++;
	}

	if (ulStatus & GPIO_PIN_6)// 如果KEY的中断状态有效
	{
		// 延时约10ms，消除按键抖动
		SysCtlDelay(10 * (SysCtlClockGet() / 3000));
		// 等待KEY抬起
		while (GPIOPinRead(GPIO_PORTD_BASE, GPIO_PIN_6) == 0x00);
		// 延时约10ms，消除松键抖动
		//TODO 逻辑处理
		if(cur_Col > 0)
			cur_Col--;
	}

}
/***************************************************************
 * @brief  	初始化ADC获取滚轮电压值
 * 		————————|
//		TIVA	    |
//		M4	PE0|<--ADC		模数转换信号源
//		________|
***************************************************************/
#define ADC_BASE		ADC0_BASE			// 使用ADC0
#define SequenceNum 	3				// 使用序列3
void Init_ADCWheel(){
	// 使能ADC0外设
	SysCtlPeripheralEnable(SYSCTL_PERIPH_ADC0);
	// 使能外设端口E
	SysCtlPeripheralEnable(SYSCTL_PERIPH_GPIOE);
	// 选择PE0为外部模拟数字转换功能
	GPIOPinTypeADC(GPIO_PORTE_BASE, GPIO_PIN_0);
	// 使能采样序列号为触发处理获取模式
	ADCSequenceConfigure(ADC_BASE, SequenceNum, ADC_TRIGGER_PROCESSOR, 0);
	// ADC配置

	ADCSequenceStepConfigure(ADC_BASE, SequenceNum, 0, ADC_CTL_CH3 | ADC_CTL_IE |ADC_CTL_END);
	// 使能ADC配置
	ADCSequenceEnable(ADC_BASE, SequenceNum);
	// 清除ADC中断标志位
	ADCIntClear(ADC_BASE, SequenceNum);
}


/***************************************************************
 * @brief   获取特定ADC的模数转化采样值。
 * @param   ui32Base            ADC采样基地址
 * @param   ui32Peripheral   ADC启动的外设端口
 * @return                        ADC采样值
***************************************************************/
unsigned long ADC_ValueGet(uint32_t ui32Base, uint32_t ui32SequenceNum)
{
    unsigned long value = 0;
// 保存ADC采样值
    uint32_t ADCValue[1];
    // 触发获取端口采样
    ADCProcessorTrigger(ui32Base, ui32SequenceNum);
    //等待采样结束
    while(!ADCIntStatus(ui32Base, ui32SequenceNum, false))
    {
    }
    // 清除ADC采样中断标志
    ADCIntClear(ui32Base, ui32SequenceNum);
    // 读取ADC采样值
    ADCSequenceDataGet(ui32Base, ui32SequenceNum, ADCValue);
    value = ADCValue[0];
    return value;
}




/***************************************************************
 * @brief   刷屏函数
 * @param   二进制矩阵
 * @return   NULL                   
***************************************************************/

void screen_wape(bool pos[64][128]) {
	int m, n, i;
	unsigned char k[8][128];
	union screen a;
	for (n = 0; n < 7; n++) {
		for (m = 0; m < 128; m++) {
			a.bit1 = pos[8 * n-7+ 8][m];
			a.bit2 = pos[8 * n - 6 + 8][m];
			a.bit3 = pos[8 * n - 5 + 8][m];
			a.bit4 = pos[8 * n - 4 + 8][m];
			a.bit5 = pos[8 * n - 3 + 8][m];
			a.bit6 = pos[8 * n - 2 + 8][m];
			a.bit7 = pos[8 * n - 1 + 8][m];
			a.bit8 = pos[8 * n - 0 + 8][m];
			k[n][m] = a.a;
			

		}
		
		
	}

	screenpage(0,k[0], 128);
	screenpage(1,k[1], 128);
	screenpage(2, k[2], 128);
	screenpage(3,k[3], 128);
	screenpage(4,k[4], 128);
	screenpage(5, k[5], 128);
	screenpage(6,k[6], 128);
 //screenpage(7,k[7], 128);

}





/************************************************************
 * @brief  	对端口C、D进行按键中断初始化
 * @param	none
 * @param	none
 ***********************************************************/
void Init_Int_Key() {
	
  SysCtlPeripheralEnable(SYSCTL_PERIPH_GPIOD);

	HWREG(GPIO_PORTD_BASE+GPIO_O_LOCK)  |= GPIO_LOCK_KEY;

	HWREG(GPIO_PORTD_BASE+GPIO_O_CR)   |= (1<<7);

	HWREG(GPIO_PORTD_BASE+GPIO_O_DEN)  &=(~(1<<7));

	 HWREG(GPIO_PORTD_BASE+GPIO_O_PDR)  &= (~(1<<7));

	HWREG(GPIO_PORTD_BASE+GPIO_O_PUR)  &= (~(1<<7));

	HWREG(GPIO_PORTD_BASE+GPIO_O_AFSEL) &=(~(1<<7));

	// Make PD6/7 an output.
	
	GPIODirModeSet(GPIO_PORTD_BASE, GPIO_PIN_6 | GPIO_PIN_7, GPIO_DIR_MODE_IN);

	GPIOPadConfigSet(GPIO_PORTD_BASE, GPIO_PIN_6 | GPIO_PIN_7, GPIO_STRENGTH_2MA,
			GPIO_PIN_TYPE_STD_WPU);

	GPIOIntTypeSet(GPIO_PORTD_BASE, GPIO_PIN_6 | GPIO_PIN_7, GPIO_LOW_LEVEL);

	GPIOIntEnable(GPIO_PORTD_BASE, GPIO_PIN_6 | GPIO_PIN_7);

	//IntEnable(INT_GPIOD_TM4C123);
	IntEnable(INT_GPIOD);

	IntMasterEnable();

	GPIOIntClear(GPIO_PORTD_BASE, GPIO_PIN_6 | GPIO_PIN_7);
}



extern void screenpage(char page,unsigned char *p,int l);





static bool cube[64][128];

	
int main(void) {

	// 设置系统主频
	SysCtlClockSet(SYSCTL_SYSDIV_1 | SYSCTL_USE_PLL | SYSCTL_OSC_MAIN
							| SYSCTL_XTAL_16MHZ);

	Init_ADCWheel();

	Init_Int_Key();

	LCD_Enable();						// 使能LCD
	LCD_Init();							// 初始化LCD
	LCD_ScreenClr();					// 清屏
	
	screenpage(1,startPicture[1], 128);
	screenpage(2, startPicture[2], 128);
	screenpage(3,startPicture[3], 128);
	screenpage(4,startPicture[4], 128);
	screenpage(5, startPicture[5], 128);
	screenpage(6,startPicture[6], 128);
 screenpage(7,startPicture[7], 128);
 
		while (1)
		{
	};
}



/*
		screenpage(0,a1, 128);
	screenpage(1,b1, 128);
	screenpage(2, c1, 128);
	screenpage(3,d1, 128);
	screenpage(4,e1, 128);
	screenpage(5, f1, 128);
	screenpage(6,g1, 128);
 screenpage(7,h1, 128);
		
	LCD_Draw_Char_8x8('S', 7, 1,1);
	LCD_Draw_Char_8x8('c', 7, 2,1);
	LCD_Draw_Char_8x8('o', 7, 3,1);
	LCD_Draw_Char_8x8('r', 7, 4,1);
	LCD_Draw_Char_8x8('e', 7, 5,1);
	LCD_Draw_Char_8x8(':', 7, 6,1);
  LCD_Draw_Num((float)(score), 0, 7,7, 1);
	

	*/


	

	


